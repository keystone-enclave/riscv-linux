## Documentation/devicetree/bindings/clock/exynos4-clock.txt
```
* Samsung Exynos4 Clock Controller

The Exynos4 clock controller generates and supplies clock to various controllers
within the Exynos4 SoC. The clock binding described here is applicable to all
SoC's in the Exynos4 family.

Required Properties:

- compatible: should be one of the following.
  - "samsung,exynos4210-clock" - controller compatible with Exynos4210 SoC.
  - "samsung,exynos4412-clock" - controller compatible with Exynos4412 SoC.

- reg: physical base address of the controller and length of memory mapped
  region.

- #clock-cells: should be 1.

Each clock is assigned an identifier and client nodes can use this identifier
to specify the clock which they consume.

All available clocks are defined as preprocessor macros in
dt-bindings/clock/exynos4.h header and can be used in device
tree sources.

Example 1: An example of a clock controller node is listed below.

	clock: clock-controller@0x10030000 {
		compatible = "samsung,exynos4210-clock";
		reg = <0x10030000 0x20000>;
		#clock-cells = <1>;
	};

Example 2: UART controller node that consumes the clock generated by the clock
	   controller. Refer to the standard clock bindings for information
	   about 'clocks' and 'clock-names' property.

	serial@13820000 {
		compatible = "samsung,exynos4210-uart";
		reg = <0x13820000 0x100>;
		interrupts = <0 54 0>;
		clocks = <&clock CLK_UART2>, <&clock CLK_SCLK_UART2>;
		clock-names = "uart", "clk_uart_baud0";
	};

Exynos4412 SoC contains some additional clocks for FIMC-ISP (Camera ISP)
subsystem. Registers for those clocks are partially located in the SOC area,
which belongs to ISP power domain. Because those registers are also located
in a different memory region than the main clock controller, a separate clock
controller has to be defined for handling them. The compatible string to such
controller is "samsung,exynos4412-isp-clock". It also has two input clocks
from the main Exynos4412 clock controller: "aclk200" and "aclk400_mcuisp".
The ISP clock controller has to be linked with respective ISP power domain
(for more information, see Samsung Exynos power domains bindings).

Example 3: An example of a clock controllers for Exynos4412 SoCs.

	clock: clock-controller@10030000 {
		compatible = "samsung,exynos4412-clock";
		reg = <0x10030000 0x18000>;
		#clock-cells = <1>;
	};

	isp_clock: clock-controller@10048000 {
		compatible = "samsung,exynos4412-isp-clock";
		reg = <0x10048000 0x1000>;
		#clock-cells = <1>;
		power-domains = <&pd_isp>;
		clocks = <&clock CLK_ACLK200>, <&clock CLK_ACLK400_MCUISP>;
		clock-names = "aclk200", "aclk400_mcuisp";
	};
```

## Documentation/devicetree/bindings/gpio/actions,owl-gpio.txt
```
* Actions Semi OWL GPIO controller bindings

The GPIOs are organized as individual banks/ports with variable number
of GPIOs. Each bank is represented as an individual GPIO controller.

Required properties:
- compatible            : Should be "actions,s900-gpio"
- reg                   : Address and range of the GPIO controller registers.
- gpio-controller       : Marks the device node as a GPIO controller.
- #gpio-cells           : Should be <2>. The first cell is the gpio number
                          and the second cell is used to specify optional
                          parameters.
- ngpios                : Specifies the number of GPIO lines.
- interrupt-controller  : Marks the device node as an interrupt controller.
- #interrupt-cells      : Specifies the number of cells needed to encode an
                          interrupt.  Shall be set to 2.  The first cell
                          defines the interrupt number, the second encodes
                          the trigger flags described in
                          bindings/interrupt-controller/interrupts.txt

Optional properties:
- gpio-ranges           : Mapping between GPIO and pinctrl

Examples:

       gpioa: gpio@e01b0000 {
               compatible = "actions,s900-gpio";
               reg = <0x0 0xe01b0000 0x0 0x000c>;
               gpio-controller;
               #gpio-cells = <2>;
               gpio-ranges = <&pinctrl 0 0 32>;
               interrupt-controller;
               #interrupt-cells = <2>;
       };

       gpiob: gpio@e01b000c {
               compatible = "actions,s900-gpio";
               reg = <0x0 0xe01b000c 0x0 0x000c>;
               gpio-controller;
               #gpio-cells = <2>;
               gpio-ranges = <&pinctrl 0 32 32>;
               interrupt-controller;
               #interrupt-cells = <2>;
       };

       gpioc: gpio@e01b0018 {
               compatible = "actions,s900-gpio";
               reg = <0x0 0xe01b0018 0x0 0x000c>;
               gpio-controller;
               #gpio-cells = <2>;
               gpio-ranges = <&pinctrl 0 64 12>;
               ngpios = <12>;
               interrupt-controller;
               #interrupt-cells = <2>;
       };

       gpiod: gpio@e01b0024 {
               compatible = "actions,s900-gpio";
               reg = <0x0 0xe01b0024 0x0 0x000c>;
               gpio-controller;
               #gpio-cells = <2>;
               gpio-ranges = <&pinctrl 0 76 30>;
               ngpios = <30>;
               interrupt-controller;
               #interrupt-cells = <2>;
       };

       gpioe: gpio@e01b0030 {
               compatible = "actions,s900-gpio";
               reg = <0x0 0xe01b0030 0x0 0x000c>;
               gpio-controller;
               #gpio-cells = <2>;
               gpio-ranges = <&pinctrl 0 106 32>;
               interrupt-controller;
               #interrupt-cells = <2>;
       };

       gpiof: gpio@e01b00f0 {
               compatible = "actions,s900-gpio";
               reg = <0x0 0xe01b00f0 0x0 0x000c>;
               gpio-controller;
               #gpio-cells = <2>;
               gpio-ranges = <&pinctrl 0 138 8>;
               ngpios = <8>;
               interrupt-controller;
               #interrupt-cells = <2>;
       };
```

## drivers/soc/bcm/brcmstb/Kconfig
```kconfig
if SOC_BRCMSTB

config BRCMSTB_PM
	bool "Support suspend/resume for STB platforms"
	default y
	depends on PM
	depends on ARM

endif # SOC_BRCMSTB
```
